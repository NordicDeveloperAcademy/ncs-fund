## l3/l3_e1_sol/sample.yaml
```yaml
sample:
  name: nRF Connect SDK Fundamentals Course - Lesson 3 Exercise 1 Solution
  
common: 
    sysbuild: true
    build_only: true
    skip: true
    integration_platforms: 
      - nrf52dk/nrf52832
      - nrf52833dk/nrf52833
      - nrf52840dk/nrf52840
      - nrf9160dk/nrf9160/ns
      - nrf9161dk/nrf9161/ns
      - nrf9151dk/nrf9151/ns
      - nrf5340dk/nrf5340/cpuapp
      - nrf5340dk/nrf5340/cpuapp/ns
      - nrf54l15dk/nrf54l15/cpuapp
      - nrf54l15dk/nrf54l15/cpuapp/ns
      - nrf7002dk/nrf5340/cpuapp
      - nrf7002dk/nrf5340/cpuapp/ns
      - thingy53/nrf5340/cpuapp
      - thingy53/nrf5340/cpuapp/ns
      - thingy91/nrf9160/ns
      - thingy91x/nrf9151/ns
    platform_exclude:
      - native_sim
    
tests:
  ncs_fund.l3.e1_sol: {}
```

## l3/l3_e2_sol/Kconfig
```kconfig
#
# Copyright (c) 2020 Nordic Semiconductor
#
# SPDX-License-Identifier: LicenseRef-Nordic-5-Clause
#

source "Kconfig.zephyr"

# STEP 6 - Define a custom Kconfig for enabling myfunction
config MYFUNCTION
	bool "Enable my function"
	default n
```

## l4/l4_e1_sol/sample.yaml
```yaml
sample:
  name: nRF Connect SDK Fundamentals Course - Lesson 4 Exercise 1 Solution
  
common: 
    sysbuild: true
    integration_platforms: 
      - nrf52dk/nrf52832
      - nrf52833dk/nrf52833
      - nrf52840dk/nrf52840
      - nrf9160dk/nrf9160
      - nrf9161dk/nrf9161
      - nrf9151dk/nrf9151
      - nrf5340dk/nrf5340/cpuapp
      - nrf54l15dk/nrf54l15/cpuapp
      - nrf54lm20dk/nrf54lm20a/cpuapp
      - nrf54ls05dk/nrf54ls05b/cpuapp
      - nrf7002dk/nrf5340/cpuapp
      - thingy53/nrf5340/cpuapp
      - thingy91/nrf9160
      - thingy91x/nrf9151
    platform_allow:
      - nrf52dk/nrf52832
      - nrf52833dk/nrf52833
      - nrf52840dk/nrf52840
      - nrf9160dk/nrf9160
      - nrf9161dk/nrf9161
      - nrf9151dk/nrf9151
      - nrf5340dk/nrf5340/cpuapp
      - nrf54l15dk/nrf54l15/cpuapp
      - nrf54lm20dk/nrf54lm20a/cpuapp
      - nrf54ls05dk/nrf54ls05b/cpuapp
      - nrf7002dk/nrf5340/cpuapp
      - thingy53/nrf5340/cpuapp
      - thingy91/nrf9160
      - thingy91x/nrf9151
    
tests:
  ncs_fund.l4.e1_sol:
    harness: console
    harness_config:
      type: one_line
      regex:
        - "nRF Connect SDK Fundamentals - Lesson 4 - Exercise 1"
    timeout: 15
```

## l6/l6_e2_sol/sample.yaml
```yaml
sample:
  name: nRF Connect SDK Fundamentals Course - Lesson 6 Exercise 2 Solution
  
common: 
    sysbuild: true
    integration_platforms: 
      - thingy53/nrf5340/cpuapp
      - thingy91/nrf9160
    platform_allow: 
      - thingy53/nrf5340/cpuapp
      - thingy91/nrf9160

    
tests:
  ncs_fund.l6.e2_sol:
    harness: console
    harness_config:
      type: one_line
      regex:
        - "Starting Lesson 6 - Exercise 2"
    timeout: 15
```

## v2.9.0-v2.7.0/l6/l6_e1/sample.yaml
```yaml
sample:
  name: nRF Connect SDK Fundamentals Course - Lesson 6 Exercise 1
  
common: 
    sysbuild: true
    build_only: true
    skip: true
    integration_platforms: 
      - nrf52dk/nrf52832
      - nrf52833dk/nrf52833
      - nrf52840dk/nrf52840
      - nrf9160dk/nrf9160/ns
      - nrf9160dk/nrf9160
      - nrf9161dk/nrf9161/ns
      - nrf9161dk/nrf9161
      - nrf9151dk/nrf9151/ns
      - nrf9151dk/nrf9151      
      - nrf5340dk/nrf5340/cpuapp
      - nrf5340dk/nrf5340/cpuapp/ns
      - nrf54l15dk/nrf54l15/cpuapp
      - nrf54l15dk/nrf54l15/cpuapp/ns
      - nrf7002dk/nrf5340/cpuapp
      - nrf7002dk/nrf5340/cpuapp/ns
    platform_exclude:
      - native_sim
    
tests:
  l6.e1: {}
```

## v2.x.x/lesson3/fund_less3_exer2_solution/Kconfig
```kconfig
source "Kconfig.zephyr"

config MYFUNCTION
	bool "Enable my function"
	default n
```

## v2.x.x/lesson6/fund_less6_exer1_solution/boards/nrf9151dk_nrf9151_ns.conf
```kconfig
#UART1 is used for TF-M logging should be disabled
CONFIG_TFM_SECURE_UART=n
CONFIG_TFM_LOG_LEVEL_SILENCE=y
```
