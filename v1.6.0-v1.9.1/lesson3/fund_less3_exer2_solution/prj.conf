## CMakeLists.txt
```
#
# Copyright (c) 2020 Nordic Semiconductor
#
# SPDX-License-Identifier: LicenseRef-Nordic-5-Clause
#

cmake_minimum_required(VERSION 3.20.0)
find_package(Zephyr REQUIRED HINTS $ENV{ZEPHYR_BASE})

project(nrf_connect_sdk_fundamentals)

target_sources(app PRIVATE src/main.c)
target_sources_ifdef(CONFIG_MYFUNCTION app PRIVATE src/myfunction.c)
```

## prj.conf
```kconfig
CONFIG_MYFUNCTION=y
```

## src/main.c
```c
/*
 * Copyright (c) 2022 Nordic Semiconductor ASA
 *
 * SPDX-License-Identifier: LicenseRef-Nordic-5-Clause
 */

#include <zephyr.h>
#include <sys/printk.h>
//#include "myfunction.h"

void main(void)
{
	int a = 3, b = 4;
	while(1){
		if(!(IS_ENABLED(CONFIG_MYFUNCTION))){
			printk("MYFUNCTION not enabled\r\n");
			return;
		}
		printk("The sum of %d and %d is %d\n\r", a, b, sum(a,b));
		k_msleep(1000);
	}
}
```

## src/myfunction.c
```c
#include "myfunction.h"

int sum(int a, int b){
    return a+b;
}
```
