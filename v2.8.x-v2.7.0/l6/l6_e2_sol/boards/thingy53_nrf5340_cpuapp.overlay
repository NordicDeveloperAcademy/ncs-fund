/*
 * Copyright (c) 2021 Nordic Semiconductor ASA
 *
 * SPDX-License-Identifier: LicenseRef-Nordic-5-Clause
 */


&i2c1{
	bh1749: bh1749@38 {
			compatible = "rohm,bh1749";
			reg = <0x38>;
			int-gpios = <&gpio1 5 (GPIO_PULL_UP |GPIO_ACTIVE_LOW)>;
	};
};